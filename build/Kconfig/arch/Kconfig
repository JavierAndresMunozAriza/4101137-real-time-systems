## build/Kconfig/arch/Kconfig
```kconfig
# Load Zephyr Arch Kconfig descriptions.
osource "/home/xavi/zephyrproject/zephyr/arch/hexagon/Kconfig"
osource "/home/xavi/zephyrproject/zephyr/arch/rx/Kconfig"
osource "/home/xavi/zephyrproject/zephyr/arch/x86/Kconfig"
osource "/home/xavi/zephyrproject/zephyr/arch/xtensa/Kconfig"
osource "/home/xavi/zephyrproject/zephyr/arch/sparc/Kconfig"
osource "/home/xavi/zephyrproject/zephyr/arch/riscv/Kconfig"
osource "/home/xavi/zephyrproject/zephyr/arch/posix/Kconfig"
osource "/home/xavi/zephyrproject/zephyr/arch/openrisc/Kconfig"
osource "/home/xavi/zephyrproject/zephyr/arch/mips/Kconfig"
osource "/home/xavi/zephyrproject/zephyr/arch/arm64/Kconfig"
osource "/home/xavi/zephyrproject/zephyr/arch/arm/Kconfig"
osource "/home/xavi/zephyrproject/zephyr/arch/arc/Kconfig"
```

## build/Kconfig/boards/Kconfig.defconfig
```kconfig
# Load Zephyr board defconfig descriptions.
osource "/home/xavi/zephyrproject/zephyr/boards/espressif/esp32s3_devkitc/Kconfig.defconfig"
```

## build/Kconfig/boards/Kconfig.esp32s3_devkitc
```kconfig
# Load board Kconfig descriptions.
osource "/home/xavi/zephyrproject/zephyr/boards/espressif/esp32s3_devkitc/Kconfig.esp32s3_devkitc"
```

## build/Kconfig/boards/Kconfig.sysbuild
```kconfig
# Load Sysbuild board Kconfig descriptions.
osource "/home/xavi/zephyrproject/zephyr/boards/espressif/esp32s3_devkitc/Kconfig.sysbuild"
```

## build/Kconfig/soc/Kconfig
```kconfig
# Load Zephyr SoC Kconfig descriptions.
osource "/home/xavi/zephyrproject/zephyr/soc/xlnx/zynqmp/Kconfig"
osource "/home/xavi/zephyrproject/zephyr/soc/xlnx/zynq7000/Kconfig"
osource "/home/xavi/zephyrproject/zephyr/soc/xlnx/versalnet/Kconfig"
osource "/home/xavi/zephyrproject/zephyr/soc/xlnx/versal2/Kconfig"
osource "/home/xavi/zephyrproject/zephyr/soc/xlnx/versal/Kconfig"
osource "/home/xavi/zephyrproject/zephyr/soc/xen/Kconfig"
osource "/home/xavi/zephyrproject/zephyr/soc/wch/ch32v/Kconfig"
osource "/home/xavi/zephyrproject/zephyr/soc/ti/tiva_c/Kconfig"
osource "/home/xavi/zephyrproject/zephyr/soc/ti/simplelink/Kconfig"
osource "/home/xavi/zephyrproject/zephyr/soc/ti/mspm/Kconfig"
osource "/home/xavi/zephyrproject/zephyr/soc/ti/lm3s6965/Kconfig"
osource "/home/xavi/zephyrproject/zephyr/soc/ti/k3/Kconfig"
osource "/home/xavi/zephyrproject/zephyr/soc/ti/am13/Kconfig"
osource "/home/xavi/zephyrproject/zephyr/soc/telink/tlsr/Kconfig"
osource "/home/xavi/zephyrproject/zephyr/soc/syna/sr100/Kconfig"
osource "/home/xavi/zephyrproject/zephyr/soc/starfive/jh71xx/Kconfig"
osource "/home/xavi/zephyrproject/zephyr/soc/st/stm32/Kconfig"
osource "/home/xavi/zephyrproject/zephyr/soc/snps/qemu_arc/Kconfig"
osource "/home/xavi/zephyrproject/zephyr/soc/snps/nsim/arc_v/Kconfig"
osource "/home/xavi/zephyrproject/zephyr/soc/snps/nsim/arc_classic/Kconfig"
osource "/home/xavi/zephyrproject/zephyr/soc/snps/hsdk4xd/Kconfig"
osource "/home/xavi/zephyrproject/zephyr/soc/snps/hsdk/Kconfig"
osource "/home/xavi/zephyrproject/zephyr/soc/snps/emsk/Kconfig"
osource "/home/xavi/zephyrproject/zephyr/soc/snps/emsdp/Kconfig"
osource "/home/xavi/zephyrproject/zephyr/soc/snps/arc_iot/Kconfig"
osource "/home/xavi/zephyrproject/zephyr/soc/silabs/Kconfig"
osource "/home/xavi/zephyrproject/zephyr/soc/sifli/sf32/Kconfig"
osource "/home/xavi/zephyrproject/zephyr/soc/sifive/sifive_freedom/Kconfig"
osource "/home/xavi/zephyrproject/zephyr/soc/shakti/Kconfig"
osource "/home/xavi/zephyrproject/zephyr/soc/sensry/Kconfig"
osource "/home/xavi/zephyrproject/zephyr/soc/rockchip/Kconfig"
osource "/home/xavi/zephyrproject/zephyr/soc/renode/riscv_virtual/Kconfig"
osource "/home/xavi/zephyrproject/zephyr/soc/renode/cortex_r8_virtual/Kconfig"
osource "/home/xavi/zephyrproject/zephyr/soc/renesas/smartbond/Kconfig"
osource "/home/xavi/zephyrproject/zephyr/soc/renesas/rz/Kconfig"
osource "/home/xavi/zephyrproject/zephyr/soc/renesas/rx/Kconfig"
osource "/home/xavi/zephyrproject/zephyr/soc/renesas/rcar/Kconfig"
osource "/home/xavi/zephyrproject/zephyr/soc/renesas/ra/Kconfig"
osource "/home/xavi/zephyrproject/zephyr/soc/realtek/fingerprint/Kconfig"
osource "/home/xavi/zephyrproject/zephyr/soc/realtek/ec/Kconfig"
osource "/home/xavi/zephyrproject/zephyr/soc/realtek/bee/Kconfig"
osource "/home/xavi/zephyrproject/zephyr/soc/realtek/ameba/Kconfig"
osource "/home/xavi/zephyrproject/zephyr/soc/raspberrypi/rpi_pico/Kconfig"
osource "/home/xavi/zephyrproject/zephyr/soc/quicklogic/eos_s3/Kconfig"
osource "/home/xavi/zephyrproject/zephyr/soc/qemu/virt_riscv/Kconfig"
osource "/home/xavi/zephyrproject/zephyr/soc/qemu/or1k/Kconfig"
osource "/home/xavi/zephyrproject/zephyr/soc/qemu/malta/Kconfig"
osource "/home/xavi/zephyrproject/zephyr/soc/qemu/hexagon/Kconfig"
osource "/home/xavi/zephyrproject/zephyr/soc/openisa/rv32m1/Kconfig"
osource "/home/xavi/zephyrproject/zephyr/soc/openhwgroup/cva6/Kconfig"
osource "/home/xavi/zephyrproject/zephyr/soc/oct/osd32mp15x/Kconfig"
osource "/home/xavi/zephyrproject/zephyr/soc/nxp/s32/Kconfig"
osource "/home/xavi/zephyrproject/zephyr/soc/nxp/rw/Kconfig"
osource "/home/xavi/zephyrproject/zephyr/soc/nxp/mcx/Kconfig"
osource "/home/xavi/zephyrproject/zephyr/soc/nxp/lpc/Kconfig"
osource "/home/xavi/zephyrproject/zephyr/soc/nxp/layerscape/Kconfig"
osource "/home/xavi/zephyrproject/zephyr/soc/nxp/kinetis/Kconfig"
osource "/home/xavi/zephyrproject/zephyr/soc/nxp/imxrt/Kconfig"
osource "/home/xavi/zephyrproject/zephyr/soc/nxp/imx/Kconfig"
osource "/home/xavi/zephyrproject/zephyr/soc/nuvoton/numicro/Kconfig"
osource "/home/xavi/zephyrproject/zephyr/soc/nuvoton/numaker/Kconfig"
osource "/home/xavi/zephyrproject/zephyr/soc/nuvoton/npcx/Kconfig"
osource "/home/xavi/zephyrproject/zephyr/soc/nuvoton/npcm/Kconfig"
osource "/home/xavi/zephyrproject/zephyr/soc/nordic/Kconfig"
osource "/home/xavi/zephyrproject/zephyr/soc/neorv32/Kconfig"
osource "/home/xavi/zephyrproject/zephyr/soc/native/inf_clock/Kconfig"
osource "/home/xavi/zephyrproject/zephyr/soc/microchip/smartfusion2/Kconfig"
osource "/home/xavi/zephyrproject/zephyr/soc/microchip/sam/sama7/Kconfig"
osource "/home/xavi/zephyrproject/zephyr/soc/microchip/sam/sama5/Kconfig"
osource "/home/xavi/zephyrproject/zephyr/soc/microchip/sam/sam_d5x_e5x/Kconfig"
osource "/home/xavi/zephyrproject/zephyr/soc/microchip/pic64/Kconfig"
osource "/home/xavi/zephyrproject/zephyr/soc/microchip/pic32c/pic32cz_ca/Kconfig"
osource "/home/xavi/zephyrproject/zephyr/soc/microchip/pic32c/pic32cx_sg/Kconfig"
osource "/home/xavi/zephyrproject/zephyr/soc/microchip/pic32c/pic32cm_sg_gc/Kconfig"
osource "/home/xavi/zephyrproject/zephyr/soc/microchip/pic32c/pic32cm_pl/Kconfig"
osource "/home/xavi/zephyrproject/zephyr/soc/microchip/pic32c/pic32cm_jh/Kconfig"
osource "/home/xavi/zephyrproject/zephyr/soc/microchip/pic32c/pic32ck_sg_gc/Kconfig"
osource "/home/xavi/zephyrproject/zephyr/soc/microchip/miv/Kconfig"
osource "/home/xavi/zephyrproject/zephyr/soc/microchip/mec/Kconfig"
osource "/home/xavi/zephyrproject/zephyr/soc/mediatek/mt8xxx/Kconfig"
osource "/home/xavi/zephyrproject/zephyr/soc/lowrisc/opentitan/Kconfig"
osource "/home/xavi/zephyrproject/zephyr/soc/litex/Kconfig"
osource "/home/xavi/zephyrproject/zephyr/soc/ite/ec/Kconfig"
osource "/home/xavi/zephyrproject/zephyr/soc/intel/wildcat_lake/Kconfig"
osource "/home/xavi/zephyrproject/zephyr/soc/intel/raptor_lake/Kconfig"
osource "/home/xavi/zephyrproject/zephyr/soc/intel/panther_lake/Kconfig"
osource "/home/xavi/zephyrproject/zephyr/soc/intel/nova_lake/Kconfig"
osource "/home/xavi/zephyrproject/zephyr/soc/intel/lakemont/Kconfig"
osource "/home/xavi/zephyrproject/zephyr/soc/intel/intel_socfpga_std/Kconfig"
osource "/home/xavi/zephyrproject/zephyr/soc/intel/intel_socfpga/Kconfig"
osource "/home/xavi/zephyrproject/zephyr/soc/intel/intel_niosv/Kconfig"
osource "/home/xavi/zephyrproject/zephyr/soc/intel/intel_ish/Kconfig"
osource "/home/xavi/zephyrproject/zephyr/soc/intel/intel_adsp/Kconfig"
osource "/home/xavi/zephyrproject/zephyr/soc/intel/elkhart_lake/Kconfig"
osource "/home/xavi/zephyrproject/zephyr/soc/intel/atom/Kconfig"
osource "/home/xavi/zephyrproject/zephyr/soc/intel/apollo_lake/Kconfig"
osource "/home/xavi/zephyrproject/zephyr/soc/intel/alder_lake/Kconfig"
osource "/home/xavi/zephyrproject/zephyr/soc/infineon/psoc4/Kconfig"
osource "/home/xavi/zephyrproject/zephyr/soc/infineon/edge/Kconfig"
osource "/home/xavi/zephyrproject/zephyr/soc/infineon/cat3/Kconfig"
osource "/home/xavi/zephyrproject/zephyr/soc/infineon/cat1c/Kconfig"
osource "/home/xavi/zephyrproject/zephyr/soc/infineon/cat1b/Kconfig"
osource "/home/xavi/zephyrproject/zephyr/soc/infineon/cat1a/Kconfig"
osource "/home/xavi/zephyrproject/zephyr/soc/gd/gd32/Kconfig"
osource "/home/xavi/zephyrproject/zephyr/soc/gaisler/leon3/Kconfig"
osource "/home/xavi/zephyrproject/zephyr/soc/gaisler/gr716a/Kconfig"
osource "/home/xavi/zephyrproject/zephyr/soc/focaltech/Kconfig"
osource "/home/xavi/zephyrproject/zephyr/soc/espressif/Kconfig"
osource "/home/xavi/zephyrproject/zephyr/soc/ene/kb1200/Kconfig"
osource "/home/xavi/zephyrproject/zephyr/soc/ene/kb106x/Kconfig"
osource "/home/xavi/zephyrproject/zephyr/soc/elan/em32f967/Kconfig"
osource "/home/xavi/zephyrproject/zephyr/soc/egis/Kconfig"
osource "/home/xavi/zephyrproject/zephyr/soc/efinix/sapphire/Kconfig"
osource "/home/xavi/zephyrproject/zephyr/soc/cdns/xtensa_sample_controller/Kconfig"
osource "/home/xavi/zephyrproject/zephyr/soc/cdns/swerv/Kconfig"
osource "/home/xavi/zephyrproject/zephyr/soc/cdns/sample_controller32/Kconfig"
osource "/home/xavi/zephyrproject/zephyr/soc/cdns/dc233c/Kconfig"
osource "/home/xavi/zephyrproject/zephyr/soc/brcm/bcmvk/Kconfig"
osource "/home/xavi/zephyrproject/zephyr/soc/brcm/bcm2712/Kconfig"
osource "/home/xavi/zephyrproject/zephyr/soc/brcm/bcm2711/Kconfig"
osource "/home/xavi/zephyrproject/zephyr/soc/brcm/bcm2710/Kconfig"
osource "/home/xavi/zephyrproject/zephyr/soc/blackberry/qnxhv_vm/Kconfig"
osource "/home/xavi/zephyrproject/zephyr/soc/bflb/Kconfig"
osource "/home/xavi/zephyrproject/zephyr/soc/atmel/sam0/Kconfig"
osource "/home/xavi/zephyrproject/zephyr/soc/atmel/sam/Kconfig"
osource "/home/xavi/zephyrproject/zephyr/soc/aspeed/Kconfig"
osource "/home/xavi/zephyrproject/zephyr/soc/arm/Kconfig"
osource "/home/xavi/zephyrproject/zephyr/soc/antmicro/myra/Kconfig"
osource "/home/xavi/zephyrproject/zephyr/soc/andestech/Kconfig"
osource "/home/xavi/zephyrproject/zephyr/soc/amd/acp_7_x/Kconfig"
osource "/home/xavi/zephyrproject/zephyr/soc/amd/acp_7_0/Kconfig"
osource "/home/xavi/zephyrproject/zephyr/soc/amd/acp_6_0/Kconfig"
osource "/home/xavi/zephyrproject/zephyr/soc/ambiq/Kconfig"
osource "/home/xavi/zephyrproject/zephyr/soc/allwinner/sun8i_h3/Kconfig"
osource "/home/xavi/zephyrproject/zephyr/soc/allwinner/sun50i_h618/Kconfig"
osource "/home/xavi/zephyrproject/zephyr/soc/alif/ensemble/Kconfig"
osource "/home/xavi/zephyrproject/zephyr/soc/alif/balletto/Kconfig"
osource "/home/xavi/zephyrproject/zephyr/soc/aesc/Kconfig"
osource "/home/xavi/zephyrproject/zephyr/soc/adi/max32/Kconfig"
```
